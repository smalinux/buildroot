## package/libfoo/Config.in
```kconfig
config BR2_PACKAGE_LIBFOO
	bool "libfoo"
	help
	  This is a comment that explains what libfoo is. The help text
	  should be wrapped.

	  http://foosoftware.org/libfoo/
```

## package/libfoo/Config.in.host
```kconfig
config BR2_PACKAGE_HOST_FOO
   bool "host foo"
   help
      This is a comment that explains what foo for the host is.

      http://foosoftware.org/foo/
```
